## config/boards/shields/altera/Kconfig.defconfig
```kconfig
if SHIELD_ALTERA_LEFT

config ZMK_KEYBOARD_NAME
    default "Altera"

config ZMK_SPLIT_ROLE_CENTRAL
    default y

endif

if SHIELD_ALTERA_LEFT || SHIELD_ALTERA_RIGHT

config ZMK_SPLIT
    default y

endif
```

## config/boards/shields/altera/Kconfig.shield
```kconfig
config SHIELD_ALTERA_LEFT
    def_bool $(shields_list_contains,altera_left)

config SHIELD_ALTERA_RIGHT
    def_bool $(shields_list_contains,altera_right)
```
